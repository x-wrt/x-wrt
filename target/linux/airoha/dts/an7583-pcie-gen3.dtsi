// SPDX-License-Identifier: (GPL-2.0-only OR BSD-2-Clause)

/* Opt-in for boards populated with a Gen3 PCIe endpoint. */
&{/soc} {
	pcie0_phy: phy@1fc7f000 {
		compatible = "airoha,an7583-pcie-gen3-phy";
		reg = <0x0 0x1fc7f000 0x0 0x1000>,
		      <0x0 0x1fc7e000 0x0 0x1000>,
		      <0x0 0x1fc30044 0x0 0x4>,
		      <0x0 0x1fc35030 0x0 0x4>;
		reg-names = "g3-ana", "g3-pma", "xr-dtime", "rx-aeq";
		#phy-cells = <0>;
	};

	pcie0: pcie@1fc20000 {
		compatible = "airoha,an7583-pcie-gen3";
		device_type = "pci";
		linux,pci-domain = <0>;
		#address-cells = <3>;
		#size-cells = <2>;
		reg = <0x0 0x1fc20000 0x0 0x1670>;
		reg-names = "pcie-mac";
		clocks = <&scuclk EN7523_CLK_PCIE>;
		clock-names = "sys-ck";
		phys = <&pcie0_phy>;
		phy-names = "pcie-phy";
		num-lanes = <1>;
		max-link-speed = <3>;
		resets = <&scuclk AN7583_PCIE0_RST>;
		reset-names = "phy-lane0";
		mediatek,pbus-csr = <&pbus_csr 0x0 0x4>;
		ranges = <0x02000000 0 0x20000000 0x0 0x20000000 0 0x4000000>;
		interrupts = <GIC_SPI 39 IRQ_TYPE_LEVEL_HIGH>;
		bus-range = <0x00 0xff>;
		#interrupt-cells = <1>;
		interrupt-map-mask = <0 0 0 7>;
		interrupt-map = <0 0 0 1 &pcie_intc0 0>,
				<0 0 0 2 &pcie_intc0 1>,
				<0 0 0 3 &pcie_intc0 2>,
				<0 0 0 4 &pcie_intc0 3>;
		status = "disabled";

		pcie_intc0: interrupt-controller {
			interrupt-controller;
			#address-cells = <0>;
			#interrupt-cells = <1>;
		};
	};
};
