// SPDX-License-Identifier: GPL-2.0-or-later OR MIT

#include "qcom-ipq4019-r619ac.dtsi"

/ {
	model = "P&W R619AC 128M";
	compatible = "p2w,r619ac-128m";
};

&kernel_unused {
	label = "kernel";
};

&rootfs_part1 {
	label = "ubi";
	reg = <0x0 0x8000000>;
};

/delete-node/ &rootfs_part2;
