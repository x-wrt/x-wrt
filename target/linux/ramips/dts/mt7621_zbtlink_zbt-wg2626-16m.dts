#include "mt7621_zbtlink_zbt-wg2626.dtsi"

/ {
	compatible = "zbtlink,zbt-wg2626-16m", "zbtlink,zbt-wg2626", "mediatek,mt7621-soc";
	model = "Zbtlink ZBT-WG2626 (16M)";
};

&firmware {
	reg = <0x50000 0xfb0000>;
};
